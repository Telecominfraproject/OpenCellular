## conf/machine/include/sysmobts.inc
```bitbake
TARGET_ARCH = "arm"

PREFERRED_PROVIDER_virtual/kernel = "linux-sysmocom"
PREFERRED_VERSION_linux-sysmocom = "${@dict([('1.5', '3.10.84+git%')]).get(d.getVar('DISTRO_VERSION', True)[0:3],'4.9.59+git%')}"
PREFERRED_PROVIDERS += "virtual/${TARGET_PREFIX}depmod:module-init-tools-cross"

PREFERRED_VERSION_u-boot = "git"

KERNEL_IMAGETYPE = "uImage"

UBOOT_ENTRYPOINT = "0x80008000"
UBOOT_LOADADDRESS = "0x80008000"

SERIAL_CONSOLE ?= "115200 ttyS0"
EXTRA_IMAGECMD_jffs2 = "--pad --little-endian --eraseblock=0x20000 -n"

#ROOT_FLASH_SIZE = "29"

MACHINE_FEATURES = "kernel26 serial"

MACHINE_ESSENTIAL_EXTRA_RDEPENDS = "\
	${@['', 'busybox-ifplugd'][d.getVar('DISTRO_VERSION', True)[0:3] == '1.5']} \
	${@['watchdog', ''][d.getVar('VIRTUAL-RUNTIME_init_manager', True) == 'systemd']} \
	kernel \
	kernel-module-dspdl \
	kernel-module-dspdl-dm644x \
	kernel-module-fpgadl \
	kernel-module-fpgadl-par \
	kernel-module-leds-gpio \
	kernel-module-msgqueue \
	kernel-module-nls-ascii \
	kernel-module-nls-utf8 \
	kernel-module-rtfifo "

MACHINE_EXTRA_RDEPENDS = "\
	task-sysmocom-bts \
	sysmobts-firmware \
	${@['watchdog', ''][d.getVar('VIRTUAL-RUNTIME_init_manager', True) == 'systemd']} \
	"
#MACHINE_EXTRA_RRECOMMENDS = "dsplink-module"

require conf/machine/include/tune-arm926ejs.inc
require conf/machine/include/dm6446.inc

# we tune for armv5te but it ends up as armv5e on pyro and probably earlier. Help it.
ARMPKGSFX_THUMB="t"
```

## conf/machine/sysmobts2100.conf
```bitbake
# sysmoBTS 2100 machine type, based on LC15
require conf/machine/litecell15.conf

MACHINE_ESSENTIAL_EXTRA_RDEPENDS = "\
	${@['watchdog', ''][d.getVar('VIRTUAL-RUNTIME_init_manager', True) == 'systemd']} \
	kernel-module-rpmsg-proto \
	kernel-module-rpmsg-rpc \
	kernel-module-nrw-clkerr \
	kernel-module-nrw-vswr \
	kernel-module-adl5501 \
	kernel-module-industrialio-buffer-cb \
	kernel-module-input-polldev \
	kernel-module-iio-hwmon \
	kernel-module-ntc-thermistor \
	kernel-module-mcp47x6 \
	kernel-module-xilinx-xadc \
	kernel-module-industrialio \
	kernel-module-omap-remoteproc \
	kernel-module-fpgadl \
	"

MACHINE_EXTRA_RDEPENDS = "\
	task-sysmocom-bts \
	${@['watchdog', ''][d.getVar('VIRTUAL-RUNTIME_init_manager', True) == 'systemd']} \
	"
EXTRA_IMAGEDEPENDS += "sysmobts2100-devtools"
```

## conf/machine/sysmocom-bsc-e1.conf
```bitbake
#@TYPE: Machine
#@NAME: common_pc
#@DESCRIPTION: Machine configuration for running a common x86

require sysmocom-bsc.conf

MACHINEOVERRIDES = "${MACHINE}:sysmocom-bsc"
SERIAL_CONSOLE = "19200 ttyS0"
MACHINE_CONSOLE = "console=ttyS0,19200n8"
```

## conf/machine/sysmocom-idu.conf
```bitbake
#@TYPE: Machine
#@NAME: common_pc
#@DESCRIPTION: Machine configuration for running a common x86

require conf/machine/include/tune-core2.inc
require conf/machine/include/genericx86-common.inc


PREFERRED_PROVIDER_virtual/libgl  = "mesa-dri"
PREFERRED_PROVIDER_virtual/libx11 ?= "libx11-diet"
PREFERRED_PROVIDER_virtual/xserver ?= "xserver-xf86-dri-lite"
PREFERRED_PROVIDER_virtual/xserver-xf86 ?= "xserver-xf86-dri-lite"
PREFERRED_PROVIDER_virtual/kernel = "linux-sysmocom"
PREFERRED_VERSION_linux-sysmocom = "${@dict([('1.5', '3.10.84+git%')]).get(d.getVar('DISTRO_VERSION', True)[0:3],'4.9.59+git%')}"

MACHINE_FEATURES += "kernel26 x86 usbhost pci acpi"

KERNEL_IMAGETYPE = "bzImage"

IMAGE_FSTYPES = "ext4"

# After dora core2 got renamed to core2-32
# After dora core2 got renamed to core2-32
DEFAULTTUNE := "${@['core2', 'core2-32']['core2-32' in d.getVar('AVAILTUNES', True)]}"

SERIAL_CONSOLE = "115200 ttyS0"
MACHINE_CONSOLE = "console=ttyS0,115200n8"

# We bypass swrast but we need it to be present for X to load correctly
XSERVER ?= "xserver-xf86-dri-lite \
           mesa-dri-driver-swrast \
           xf86-input-vmmouse \
           xf86-input-keyboard \
           xf86-input-evdev \
           xf86-video-vmware"

GLIBC_ADDONS = "nptl"
GLIBC_EXTRA_OECONF = "--with-tls"

#MACHINE_ESSENTIAL_EXTRA_RDEPENDS += "v86d"
MACHINE_ESSENTIAL_EXTRA_RDEPENDS = "linux-firmware-rtl-nic"

MACHINEOVERRIDES = "${MACHINE}:sysmocom-bsc"
```

## configs/defconfig
```kconfig
CONFIG_HWBASE_DEBUG_NULL		= y
CONFIG_HWBASE_DEBUG_TEXT_IO		=
CONFIG_HWBASE_STATIC_MMIO		= y
CONFIG_HWBASE_DYNAMIC_MMIO		=
CONFIG_HWBASE_TIMER_CLOCK_GETTIME	= y
CONFIG_HWBASE_TIMER_MUTIME		=
CONFIG_HWBASE_POSIX_FILE		=
CONFIG_HWBASE_DEFAULT_MMCONF		= 16\#f000_0000\#
CONFIG_HWBASE_DIRECT_PCIDEV		= y
```

## software/osmo/system-images/git/meta-sysmocom-bsp/conf/distro/include/sysmocom-defaults.conf
```bitbake
# Default to systemd
DISTRO_FEATURES_append = " systemd "
VIRTUAL-RUNTIME_init_manager = "systemd"

# Maybe only for the sysmoBTS kind of hardware?
MACHINE_FEATURES_BACKFILL_CONSIDERED = "rtc"

# Do not put the sourcecode into the debug packages
PACKAGE_DEBUG_SPLIT_STYLE = "debug-without-src"

# Enable the prserver host
PRSERV_HOST = "localhost:0"

# Delete stuff
#INHERIT += "rm_work"

# Create patched source tarballs
SOURCE_ARCHIVE_PACKAGE_TYPE = "tar"
INHERIT += " sysmocom-archive-patched-source"

# We use opkg and not rpm/smart
PACKAGE_CLASSES ?= "package_ipk"


# When using uclibc/musl.. avoid pulling in gettext. We do
# not need i18n in our tools right now.
USE_NLS = "no"


# We don't need x11, nfc, selinux, pam in our builds
DISTRO_FEATURES_remove = "x11 nfc selinux pam"

# Get rid off XZ, xkbcommon, pam, selinux for systemd and many more now
PACKAGECONFIG_pn-systemd = "compat ldconfig binfmt sysusers randomseed myhostname firstboot utmp"

# From fido on.. build curl with libssl to avoid gnutls
PACKAGECONFIG_pn-curl="ipv6 ssl zlib"

# disable libsolv as it is broken Yocto Bug #11427
PACKAGECONFIG_pn-opkg = ""
PACKAGECONFIG_pn-opkg-native = ""
```

## software/osmo/system-images/git/meta-sysmocom-bsp/conf/layer.conf
```bitbake
# We have a conf and classes directory, add to BBPATH
BBPATH := "${BBPATH}:${LAYERDIR}"

# We have a packages directory, add to BBFILES
BBFILES += "${LAYERDIR}/recipes-*/*/*.bb ${LAYERDIR}/recipes-*/*/*.bbappend"


# Fixes for the yocto version targeted
BBFILES += "${LAYERDIR}/yocto-fixes/*.bbappend ${LAYERDIR}/yocto-fixes/*/*.bb"

BBFILE_COLLECTIONS += "sysmocom-bsp"
BBFILE_PATTERN_sysmocom-bsp := "^${LAYERDIR}/"
BBFILE_PRIORITY_sysmocom-bsp = "6"
```

## software/osmo/system-images/git/meta-sysmocom-bsp/conf/machine/include/ti33x.inc
```bitbake
SOC_FAMILY = "ti33x"
require conf/machine/include/soc-family.inc

DEFAULTTUNE ?= "cortexa8hf-neon"
require conf/machine/include/tune-cortexa8.inc

PREFERRED_PROVIDER_virtual/xserver = "xserver-xorg"

# For built-in LCD, add xf86-input-tslib
XSERVER = "xserver-xorg \
           xf86-input-evdev \
           xf86-input-mouse \
           xf86-video-fbdev \
           xf86-input-keyboard"

# Default to external video, change to smallscreen for built-in LCD
GUI_MACHINE_CLASS = "bigscreen"

# Increase this everytime you change something in the kernel
MACHINE_KERNEL_PR = "r21"

KERNEL_IMAGETYPE = "zImage"

UBOOT_ARCH = "arm"
UBOOT_MACHINE = "am335x_evm_config"

UBOOT_ENTRYPOINT = "0x80008000"
UBOOT_LOADADDRESS = "0x80008000"

# Use the expected value of the ubifs filesystem's volume name in the kernel
# and u-boot.
UBI_VOLNAME = "rootfs"

# List common SoC features, may need to add touchscreen for specific machines
MACHINE_FEATURES = "kernel26 apm usbgadget usbhost vfat ext2 screen alsa ethernet"
```

## software/osmo/system-images/git/meta-sysmocom-bsp/conf/machine/include/tune-geode.inc
```bitbake
DEFAULTTUNE ?= "geode"

require conf/machine/include/tune-i586.inc

# Extra tune features
TUNEVALID[geode] = "Enable geode specific processor optimizations"
TUNE_CCARGS += "${@bb.utils.contains('TUNE_FEATURES', 'geode', '-march=geode -mtune=geode', '', d)}"

# Extra tune selections
AVAILTUNES += "geode"
TUNE_FEATURES_tune-geode ?= "${TUNE_FEATURES_tune-x86} geode"
BASE_LIB_tune-geode ?= "lib"
TUNE_PKGARCH_tune-geode = "geode"
PACKAGE_EXTRA_ARCHS_tune-geode = "${PACKAGE_EXTRA_ARCHS_tune-x86} i386 i486 i586 geode"
```

## software/osmo/system-images/git/meta-sysmocom-bsp/conf/machine/litecell15.conf
```bitbake
#@TYPE: Machine
#@NAME: Litecel15 EVM
#@DESCRIPTION: Machine configuration for the NRW Litecell15 EVM

# (omap-a15.inc)

SOC_FAMILY = "omap-a15"
require conf/machine/include/soc-family.inc

DEFAULTTUNE = "cortexa15thf-neon"
require conf/machine/include/tune-cortexa15.inc

KERNEL_IMAGETYPE = "zImage"

UBOOT_ARCH = "arm"
UBOOT_ENTRYPOINT = "0x80008000"
UBOOT_LOADADDRESS = "0x80008000"

EXTRA_IMAGEDEPENDS += "virtual/bootloader"

PREFERRED_PROVIDER_virtual/kernel = "linux-litecell15"
PREFERRED_PROVIDER_virtual/bootloader = "u-boot-litecell15"
PREFERRED_PROVIDER_u-boot = "u-boot-litecell15"

IMAGE_FSTYPES += "tar.gz"
SERIAL_CONSOLE = "115200 ttyS2"
UBOOT_MACHINE = "litecell15_config"

# Currently removing the sgx machine feature because there is no SGX package
# available for omap5
MACHINE_FEATURES = "kernel26 apm vfat ext2"

MACHINE_GPS_DEVICE = "/dev/ttyS0"
```

## software/osmo/system-images/git/meta-sysmocom-bsp/conf/machine/oc2g.conf
```bitbake
#@TYPE: Machine
#@NAME: OC-2G
#@DESCRIPTION: Machine configuration for the NRW OC-2G BTS

# (omap-a15.inc)

SOC_FAMILY = "omap-a15"
require conf/machine/include/soc-family.inc

DEFAULTTUNE = "cortexa15thf-neon"
require conf/machine/include/tune-cortexa15.inc

KERNEL_IMAGETYPE = "zImage"

UBOOT_ARCH = "arm"
UBOOT_ENTRYPOINT = "0x80008000"
UBOOT_LOADADDRESS = "0x80008000"

EXTRA_IMAGEDEPENDS += "virtual/bootloader"

PREFERRED_PROVIDER_virtual/kernel = "linux-oc2g"
PREFERRED_PROVIDER_virtual/bootloader = "u-boot-oc2g"
PREFERRED_PROVIDER_u-boot = "u-boot-oc2g"

IMAGE_FSTYPES += "tar.gz"
SERIAL_CONSOLE = "115200 ttyS2"
UBOOT_MACHINE = "oc2g_config"

# Currently removing the sgx machine feature because there is no SGX package
# available for omap5
MACHINE_FEATURES = "kernel26 apm vfat ext2"

MACHINE_GPS_DEVICE = "/dev/ttyS0"

MACHINE_ESSENTIAL_EXTRA_RDEPENDS = "\
        ${@['watchdog', ''][d.getVar('VIRTUAL-RUNTIME_init_manager', True) == 'systemd']} \
        kernel-module-rpmsg-proto \
        kernel-module-rpmsg-rpc \
        kernel-module-nrw-clkerr \
        kernel-module-nrw-vswr \
        kernel-module-adl5501 \
        kernel-module-industrialio-buffer-cb \
        kernel-module-input-polldev \
        kernel-module-iio-hwmon \
        kernel-module-ntc-thermistor \
        kernel-module-mcp47x6 \
        kernel-module-xilinx-xadc \
        kernel-module-industrialio \
        kernel-module-omap-remoteproc \
        kernel-module-fpgadl \
        "

MACHINE_EXTRA_RDEPENDS = "\
        task-sysmocom-bts \
        ${@['watchdog', ''][d.getVar('VIRTUAL-RUNTIME_init_manager', True) == 'systemd']} \
        "

KERNEL_VERSION_SANITY_SKIP="1"
EXTRA_IMAGEDEPENDS += "sysmobts2100-devtools"
```

## software/osmo/system-images/git/meta-sysmocom-bsp/conf/machine/sysmobts-v2.conf
```bitbake
#@TYPE: Machine
#@NAME: sysmocom - systems for mobile communications GmbH GSM Superfemto
#@DESCRIPTION: sysmocom - systems for mobile communications GmbH GSM Superfemto

# Make sure we build these too
EXTRA_IMAGEDEPENDS = "dvnixload-native ubl u-boot sysmobts-firmware barebox-sysmobts"
EXTRA_IMAGECMD_jffs2 = "--little-endian --eraseblock=0x20000 --pagesize=0x800 --no-cleanmarkers --pad=0x2000000 -n"

# ubifs config
MKUBIFS_ARGS ?= "-m 2048 -e 129024 -c 999"
UBINIZE_ARGS ?= "-m 2048 -p 128KiB -s 512"


IMAGE_FSTYPES ?= "tar.bz2 ubi"
require conf/machine/include/sysmobts.inc
```

## software/osmo/system-images/git/meta-sysmocom-bsp/conf/machine/sysmocom-alix.conf
```bitbake
#@TYPE: Machine
#@NAME: common_pc
#@DESCRIPTION: Machine configuration for sysmocom alix2d based hardware

require sysmocom-bsc.conf

TARGET_ARCH = "i586"

PREFERRED_PROVIDER_virtual/libgl  = "mesa-dri"
PREFERRED_PROVIDER_virtual/libx11 ?= "libx11-diet"
PREFERRED_PROVIDER_virtual/xserver ?= "xserver-xf86-dri-lite"
PREFERRED_PROVIDER_virtual/xserver-xf86 ?= "xserver-xf86-dri-lite"
PREFERRED_PROVIDER_virtual/kernel = "linux-sysmocom"
PREFERRED_VERSION_linux-sysmocom = "${@dict([('1.5', '3.10.84+git%')]).get(d.getVar('DISTRO_VERSION', True)[0:3],'4.9.59+git%')}"

require conf/machine/include/tune-geode.inc

MACHINE_FEATURES += "kernel26 x86 usbhost pci acpi"

KERNEL_IMAGETYPE = "bzImage"

IMAGE_FSTYPES ?= "tar.gz ext4"

SERIAL_CONSOLE = "38400 ttyS0"
MACHINE_CONSOLE = "console=ttyS0,38400n8"

# We bypass swrast but we need it to be present for X to load correctly
XSERVER ?= "xserver-xf86-dri-lite \
           mesa-dri-driver-swrast \
           xf86-input-vmmouse \
           xf86-input-keyboard \
           xf86-input-evdev \
           xf86-video-vmware"

GLIBC_ADDONS = "nptl"
GLIBC_EXTRA_OECONF = "--with-tls"

#MACHINE_ESSENTIAL_EXTRA_RDEPENDS += "v86d"
MACHINE_ESSENTIAL_EXTRA_RDEPENDS = "\
	${@['', 'busybox-ifplugd'][d.getVar('DISTRO_VERSION', True)[0:3] == '1.5']} \
        linux-firmware-rtl-nic "
```

## software/osmo/system-images/git/meta-sysmocom-bsp/conf/machine/sysmocom-bsc.conf
```bitbake
MACHINEOVERRIDES = "${MACHINE}:sysmocom-bsc"

MACHINE_EXTRA_RDEPENDS = "\
	dnsmasq \
	"
```

## software/osmo/system-images/git/meta-sysmocom-bsp/conf/machine/sysmocom-odu.conf
```bitbake
#@TYPE: Machine
#@NAME: sysmocom-odu
#@DESCRIPTION: Machine configuration for the sysmocom ODU

require conf/machine/include/ti33x.inc

IMAGE_FSTYPES += "ubifs"
DEFAULTTUNE = "cortexa8hf-neon"

SERIAL_CONSOLE = "115200 ttyO0"

# UBI information.  Note that this is board and kernel specific.  Changes
# in your kernel port may require changes in these variables.  For more
# details about this board please see
# http://processors.wiki.ti.com/index.php/UBIFS_Support

# do ubiattach /dev/ubi_ctrl -m 7 -O 2048
# From dmesg:
# UBI: smallest flash I/O unit:    2048
# UBI: logical eraseblock size:    126976 bytes
# from ubiattach stdout:
# UBI device number 0, total 1988 LEBs
MKUBIFS_ARGS = "-F -m 2048 -e 126976 -c 3836"

# do ubiattach /dev/ubi_ctrl -m 7 -O 2048
# from dmesg:
# UBI: smallest flash I/O unit:    2048
# UBI: physical eraseblock size:   131072 bytes (128 KiB)
# UBI: sub-page size:              512
# UBI: VID header offset:          2048 (aligned 2048)
UBINIZE_ARGS = "-m 2048 -p 128KiB -s 512 -O 2048"

# Go back to prefer our kernel
PREFERRED_PROVIDER_virtual/kernel = "linux-sysmocom"
KERNEL_IMAGETYPE = "uImage"

PREFERRED_PROVIDER_virtual/bootloader = "barebox-sysmocom-odu"
EXTRA_IMAGEDEPENDS += "barebox-sysmocom-odu"

MACHINE_ESSENTIAL_EXTRA_RDEPENDS = "\
	kernel usb2514 \
"
```
